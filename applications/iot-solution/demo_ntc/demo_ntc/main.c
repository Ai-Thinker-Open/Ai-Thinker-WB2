#include <stdio.h>
#include <string.h>
#include <FreeRTOS.h>
#include <task.h>
#include <hosal_adc.h>
#include <bl_adc.h>
#include <blog.h>

#define ADC_NTC_PIN 11
#define ADC_REF_PIN 12

#define R1 10000
#define R2 10000
#define R3 10000

const int rt_table[] = {
    2772251,
    2635767,
    2500702,
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    107,
};

uint32_t binary_search(const int *array, uint32_t size, int value)
{
    uint32_t begin = 0, end = size - 1, mid = 0, i = 0;
    if (value >= array[begin]) {
        return begin;
    }
    else if (value <= array[end]) {
        return end;
    }
    while (begin < end) {
        mid = (begin + end) / 2;
        if (value == array[mid]) {
            break;
        }
        if (value < array[mid] && value > array[mid + 1]) {
            break;
        }
        if (value > array[mid]) {
            end = mid;
        }
        else {
            begin = mid;
        }
        if (i++ > size) {
            break;
        }
    }
    
    if (begin > end) {
        return 0;
    }
    
    return mid;
}

void main(void)
{
    static hosal_adc_dev_t adc0 = {
        .cb = NULL,
        .config = {
            .mode = HOSAL_ADC_ONE_SHOT,
            .pin = ADC_NTC_PIN,
            .sampling_freq = 340,
        },
        .dma_chan = 0,
        .p_arg = NULL,
        .port = 0,
    };

    hosal_adc_init(&adc0);

    hosal_adc_add_channel(&adc0, bl_adc_get_channel_by_gpio(ADC_NTC_PIN));
    hosal_adc_add_channel(&adc0, bl_adc_get_channel_by_gpio(ADC_REF_PIN));

    for (;;)
    {
        int v_ref = hosal_adc_value_get(&adc0, bl_adc_get_channel_by_gpio(ADC_REF_PIN), 100);
        int v_ntc = hosal_adc_value_get(&adc0, bl_adc_get_channel_by_gpio(ADC_NTC_PIN), 100);

        int a = 20000u * v_ref - (v_ntc * 10000u);
        int b = v_ntc;
        int r_ntc = a / b;

        int index = binary_search(rt_table, sizeof rt_table / sizeof rt_table[0], r_ntc * 10);
        int temperature = index - 40;

        blog_info("V_REF = %ld mV\tV_NTC = %ld mV\tR_NTC = %ld ohm\tTemperature = %ld C\r\n", v_ref, v_ntc, r_ntc, temperature);

        vTaskDelay(pdMS_TO_TICKS(1000));
    }
}
